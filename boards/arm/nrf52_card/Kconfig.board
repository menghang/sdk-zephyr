## boards/arm/nrf52_card/Kconfig.board
```kconfig
# nRF52 Card board configuration

# Copyright (c) 2016 Nordic Semiconductor ASA
# SPDX-License-Identifier: Apache-2.0

config BOARD_NRF52_CARD
	bool "nRF52 Card / NRF52832"
	depends on SOC_NRF52832_QFAA
```

## boards/arm/nrf52_card/Kconfig.defconfig
```kconfig
# nRF52 Card board configuration

# Copyright (c) 2016 Nordic Semiconductor ASA
# SPDX-License-Identifier: Apache-2.0

if BOARD_NRF52_CARD

config BOARD
	default "nrf52_card"

config BT_CTLR
	default BT

endif # BOARD_NRF52DK_NRF52832
```
